## package/libglog/Config.in
```kconfig
config BR2_PACKAGE_LIBGLOG
	bool "libglog"
	depends on BR2_INSTALL_LIBSTDCPP
	help
	  Logging library for C++

	  https://github.com/google/glog/

comment "libglog needs a toolchain w/ C++"
	depends on !BR2_INSTALL_LIBSTDCPP
```
